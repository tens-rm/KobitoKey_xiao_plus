## config/dts/bindings/input/kobitokey,input-processor-mouse-batch.yaml
```yaml
description: Coalesce rapid relative mouse reports into one timed report

compatible: "kobitokey,input-processor-mouse-batch"

properties:
  "#input-processor-cells":
    type: int
    required: true
  track-remainders:
    type: boolean
    description: |
      Set on this processor node as required by ZMK's input listener.

input-processor-cells:
  - interval_ms
```

## config/dts/bindings/input/kobitokey,input-processor-pointer-trace.yaml
```yaml
description: Pass through and optionally log relative pointer input frames

compatible: "kobitokey,input-processor-pointer-trace"

properties:
  "#input-processor-cells":
    type: int
    required: true
  track-remainders:
    type: boolean

input-processor-cells: []
```
